## drivers/iio/ecompass/Kconfig
```kconfig
menu "eCompass units"

config ST_LSM303AGR_IIO
         tristate "STMicroelectronics LSM303AGR sensor"
         depends on (I2C || SPI) && SYSFS
         select IIO_BUFFER
         select IIO_TRIGGERED_BUFFER
	 select ST_LSM303AGR_I2C_IIO if (I2C)
	 select ST_LSM303AGR_SPI_IIO if (SPI)
         help
           This driver support the STMicroelectronics LSM303AGR sensor.

           To compile this driver as a module, choose M here. The module
	   will be called lsm303agr.

config ST_LSM303AGR_I2C_IIO
	tristate
	depends on ST_LSM303AGR_IIO
	depends on I2C

config ST_LSM303AGR_SPI_IIO
	tristate
	depends on ST_LSM303AGR_IIO
	depends on SPI

endmenu
```

## drivers/iio/imu/st_lsm6dsm/Kconfig
```kconfig
#
# st-lsm6dsm drivers for STMicroelectronics combo sensor
#

menuconfig ST_LSM6DSM_IIO
	tristate "STMicroelectronics LSM6DSM sensor"
	depends on (I2C || SPI) && SYSFS
	select IIO_BUFFER
	select IIO_TRIGGERED_BUFFER
	select ST_LSM6DSM_I2C_IIO if (I2C)
	select ST_LSM6DSM_SPI_IIO if (SPI)
	help
	  This driver supports the STMicroelectronics LSM6DSM sensor.
	  It is a gyroscope/accelerometer combo device.
	  This driver can be built as a module. The module will be called
	  st-lsm6dsm.

if ST_LSM6DSM_IIO

config ST_LSM6DSM_I2C_IIO
	tristate
	depends on ST_LSM6DSM_IIO
	depends on I2C

config ST_LSM6DSM_SPI_IIO
	tristate
	depends on ST_LSM6DSM_IIO
	depends on SPI

config ST_LSM6DSM_IIO_LIMIT_FIFO
	int "Limit fifo read lenght (#n byte)"
	depends on ST_LSM6DSM_IIO
	range 0 4096
	default 0
	help
	  Limit atomic fifo read to #n byte. In some platform i2c/spi read
	  can be limited by software or hardware.

	  Set 0 to disable the limit.

config ST_LSM6DSM_IIO_SENSORS_WAKEUP
	bool "All sensors can wake-up system during suspend"
	depends on ST_LSM6DSM_IIO
	default n
	help
	  If disabled only tilt and significant motion can wake-up system
	  during suspend.

	  If enabled all sensors can wake-up system during suspend.

config ST_LSM6DSM_XL_DATA_INJECTION
	bool "Enable XL data injection support"
	depends on ST_LSM6DSM_IIO
	default n
	help
	  This option enables the accelerometer data injection
	  support. The device functions may so use an injected
	  pattern instead of taking the real sensor data.

endif #ST_LSM6DSM_IIO
```

## drivers/input/fingerprint/goodix/Kconfig
```kconfig
config FINGERPRINT_GOODIX_GF3206
				tristate "Goodix GF3206 fingerprint drvier support"
				depends on INPUT_FINGERPRINT
				help
				  Say Y here to enable goodix fingerprint driver support!
```

## drivers/input/misc/goodixfp/Kconfig
```kconfig
config FINGERPRINT_GOODIX
	tristate "Goodix fingerprint support"
	help
		Say Y here enable goodix fingerprint driver support!
```

## drivers/input/touchscreen/elan/Kconfig
```kconfig
#
# Elan touchscreen driver configuration
#

if TOUCHSCREEN_ELAN

config TOUCHSCREEN_ELAN_TS
	tristate "Elan core driver module"
	depends on I2C
	help
	  Say Y here to enable basic touch reporting functionality.

	  If unsure, say N.

	  To compile this driver as a module, choose M here: the
	  module will be called elan_ts.

endif
```

## drivers/input/touchscreen/synaptics_dsx_lenovo/Kconfig
```kconfig
#
# Synaptics DSX touchscreen driver configuration
#
menuconfig TOUCHSCREEN_SYNAPTICS_DSX_LENOVO
	bool "Synaptics DSX touchscreen (Lenovo)"
	default y
	help
	  Say Y here if you have a Synaptics DSX touchscreen connected
	  to your system.

	  If unsure, say N.

if TOUCHSCREEN_SYNAPTICS_DSX_LENOVO

config TOUCHSCREEN_SYNAPTICS_DSX_I2C_LENOVO
	tristate "Synaptics DSX touchscreen char device (Lenovo)"
	help
	  This enables support for i2c interface for Synaptics DSX
	  touchscreens.

config TOUCHSCREEN_SYNAPTICS_DSX_RMI_DEV_LENOVO
	tristate "Synaptics DSX touchscreen char device (Lenovo)"
	help
	  This enables support for direct register access for Synaptics DSX
	  touchscreens.

config TOUCHSCREEN_SYNAPTICS_DSX_TEST_REPORTING_LENOVO
	tristate "Synaptics DSX touchscreen test reporting (Lenovo)"
	help
	  This enables support for test reporting for Synaptics DSX
	  touchscreens.

config TOUCHSCREEN_SYNAPTICS_DSX_FW_UPDATE_LENOVO
	tristate "Synaptics DSX touchscreen firmware update (Lenovo)"
	help
	  This enables support for firmware update for Synaptics DSX
	  touchscreens.

endif
```

## drivers/platform/lenovo/Kconfig
```kconfig
# Lenovo configuration options

config MACH_LENOVO
	bool "Lenovo device"
	depends on ARCH_MSM
	help
	  Support for Lenovo products

config MACH_LENOVO_MSM8917
	bool "Lenovo MSM8917"
	depends on ARCH_MSM8917
	select MACH_LENOVO
	help
	  Support for MSM8917 Lenovo variants

config MACH_LENOVO_MSM8953
	bool "Lenovo MSM8953"
	depends on ARCH_MSM8953
	select MACH_LENOVO
	help
	  Support for MSM8953 Lenovo variants

menu "Lenovo board selection"

config MACH_LENOVO_KUNTAO
	bool "Kuntao board"
	select MACH_LENOVO_MSM8953
	help
	  Support for Lenovo P2 (kuntao)

config MACH_LENOVO_TB8504
	bool "TB8504 board"
	select MACH_LENOVO_MSM8917
	help
	  Support for Lenovo Tab4 8 (TB8504, P3588)

config MACH_LENOVO_TB8703
	bool "TB8703 board"
	select MACH_LENOVO_MSM8953
	help
	  Support for Lenovo Tab3 8 Plus (TB8703)

config MACH_LENOVO_TB8704
	bool "TB8704 board"
	select MACH_LENOVO_MSM8953
	help
	  Support for Lenovo Tab4 8 Plus (TB8704, P3590)

config MACH_LENOVO_TB8804
	bool "TB8804 board"
	select MACH_LENOVO_MSM8953
	help
	  Support for  Lenovo Xiaoxin TB-8804 (TB8804, P3592)

config MACH_LENOVO_TBX704
	bool "TBX704 board"
	select MACH_LENOVO_MSM8953
	help
	  Support for Lenovo Tab 4 10 Plus (TBX704)

endmenu
```

## drivers/power/lenovo/Kconfig
```kconfig
config CHARGER_BQ2589X
	tristate "BQ2589x charger driver"
	depends on I2C
	help
	Say Y here to enable support for batteries with BQ27x00 (I2C/HDQ) chips.

config CHARGER_BQ2589X_DUAL
	tristate "BQ2589x charger driver"
	depends on I2C
	help
	Say Y here to enable support for batteries with BQ27x00 (I2C/HDQ) chips.

config SMB1351_USB_CHARGER
	tristate "smb1351 usb charger driver"
	depends on I2C
	help
	Say Y here to enable support for batteries with BQ27x00 (I2C/HDQ) chips.

config LENOVO_FAST_CHARGER
	tristate "lenovo fast charger driver"
	help
	Say Y here to enable support for lenovo fast charger.

config CHARGER_DUAL
	tristate "lenovo dual charger driver"
	help
	Say Y here to enable support for lenovo fast charger.

config OTG_SUPPORT
	tristate "lenovo otg support"
	help
	Say Y here to enable support for lenovo fast charger.

config CHARGING_APP_CONTROL
	tristate "lenovo charging app control support"
	help
	Say Y here to enable support for lenovo fast charger.
```

## drivers/power/onsemi/Kconfig
```kconfig
config USB_FUSB302
	bool "FUSB302 type-c PD support"
	help
	  Say Y here to enable type-c PD support.
```

## drivers/soc/qcom/unlock_bl/Kconfig
```kconfig
config LENOVO_UNLOCK_BL
	bool "lenovo_unlock_bl"
	help
         This driver helps in mitigating unlock code from LK into proc system.
	 Say Y here could be enabled with DTS parsing and copy data into userspace.
```
