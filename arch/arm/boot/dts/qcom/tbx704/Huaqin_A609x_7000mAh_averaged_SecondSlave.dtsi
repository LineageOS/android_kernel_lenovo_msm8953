
qcom,2789565_huaqin_a6000celxpert_7000mah_averaged_masterslave_feb15th2017 {
	/* #2789565_Huaqin_A6000celxpert_7000mAh_averaged_MasterSlave_Feb15th2017*/
	qcom,max-voltage-uv = <4400000>;
	qcom,nom-batt-capacity-mah = <7000>;
	qcom,batt-id-kohm = <1000>;
	qcom,battery-beta = <3380>;
	qcom,battery-type = "huaqin_a609x_7000mah_averaged_Secondslave_feb15th2017";
	qcom,fastchg-current-ma = <2500>;
	qcom,chg-rslow-comp-c1 = <3665273>;
	qcom,chg-rslow-comp-c2 = <5850989>;
	qcom,chg-rs-to-rslow = <541250>;
	qcom,chg-rslow-comp-thr = <0xB1>;
	qcom,checksum = <0x567B>;
	qcom,gui-version = "PMI8950GUI - 2.0.0.16";
	qcom,fg-profile-data = [
		 E0 83 BA 7C 
		 F0 80 DA 76 
		 64 83 18 74 
		 41 89 62 94 
		 3E 82 9C 99 
		 B5 BC 53 C9 
		 56 0F FC 83 
		 4E 7D 39 81 
		 25 77 4B 83 
		 81 71 04 6C 
		 68 7C 7F 82 
		 DE 93 CF B5 
		 C5 C1 58 11 
		 29 1C 0C 58 
		 14 70 A0 FA 
		 07 3F 6E 3D 
		 CF 38 00 00 
		 B0 46 BC 38 
		 3F 31 00 00 
		 00 00 00 00 
		 00 00 00 00 
		 5F 68 64 63 
		 62 62 F0 83 
		 AF 75 43 69 
		 41 61 6C 81 
		 FC 74 B2 68 
		 2E 7D 92 A8 
		 18 04 5B 92 
		 5C A0 71 0C 
		 28 00 FF 36 
		 F0 11 30 03 
		 00 00 00 0C 
	];
};
