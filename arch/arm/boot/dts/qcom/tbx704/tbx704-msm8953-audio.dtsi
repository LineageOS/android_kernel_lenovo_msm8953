/*
 * Copyright (c) 2015-2016, The Linux Foundation. All rights reserved.
 *
 * This program is free software; you can redistribute it and/or modify
 * it under the terms of the GNU General Public License version 2 and
 * only version 2 as published by the Free Software Foundation.
 *
 * This program is distributed in the hope that it will be useful,
 * but WITHOUT ANY WARRANTY; without even the implied warranty of
 * MERCHANTABILITY or FITNESS FOR A PARTICULAR PURPOSE.  See the
 * GNU General Public License for more details.
 */

&int_codec {
	status = "ok";
	qcom,msm-hs-micbias-type = "internal";
	qcom,cdc-us-euro-gpios = <&tlmm 9 0>;
	qcom,msm-ext-pa = "primary";
	qcom,msm-spk-ext-pa = <&tlmm 96 0>;
	qcom,msm-spk-ext-pa1 = <&tlmm 23 0>;
	qcom,msm-mbhc-hphl-swh = <1>;
	qcom,msm-mclk-freq = <9600000>;
	qcom,audio-routing =
                       "RX_BIAS", "MCLK",
                       "SPK_RX_BIAS", "MCLK",
                       "INT_LDO_H", "MCLK",
                       "MIC BIAS External", "Secondary Mic",
                       "MIC BIAS Internal1", "Handset Mic",
                       "MIC BIAS Internal2", "Headset Mic",
                       "AMIC1", "MIC BIAS Internal1",
                       "AMIC2", "MIC BIAS Internal2",
                       "AMIC3", "MIC BIAS External";
	/delete-property/ asoc-wsa-codec-names;
	/delete-property/ asoc-wsa-codec-prefixes;
	/delete-property/ msm-vdd-wsa-switch-supply;
	/delete-property/ qcom,msm-vdd-wsa-switch-voltage;
	/delete-property/ qcom,msm-vdd-wsa-switch-current;
};


