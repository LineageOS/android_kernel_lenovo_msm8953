
qcom,2789558_huaqin_a6000atl_7000mah_averaged_masterslave_feb15th2017 {
	/* #2789558_Huaqin_A6090atl_7000mAh_averaged_MasterSlave_Feb15th2017*/
	qcom,max-voltage-uv = <4400000>;
	qcom,nom-batt-capacity-mah = <7000>;
	qcom,batt-id-kohm = <100>;
	qcom,battery-beta = <3380>;
	qcom,battery-type = "huaqin_a6090atl_7000mah_averaged_masterslave_feb15th2017";
	qcom,fastchg-current-ma = <2500>;
	qcom,chg-rslow-comp-c1 = <2142822>;
	qcom,chg-rslow-comp-c2 = <2002658>;
	qcom,chg-rs-to-rslow = <507641>;
	qcom,chg-rslow-comp-thr = <0x99>;
	qcom,checksum = <0x6F5D>;
	qcom,gui-version = "PMI8950GUI - 2.0.0.16";
	qcom,fg-profile-data = [
		 EE 83 4C 7D 
		 72 81 F2 77 
		 59 83 DA 5C 
		 76 81 66 8C 
		 3D 82 C5 99 
		 0B BD 0B CA 
		 5C 0E 0A 88 
		 47 7E 24 82 
		 9E 7C 56 83 
		 B4 68 8A 7A 
		 5D 87 4F 82 
		 B8 99 15 BD 
		 1F CA 5B 0D 
		 88 1B AF 58 
		 14 70 A0 FA 
		 76 3D 08 3E 
		 FE 32 00 00 
		 0C 45 AA 21 
		 3E 25 00 00 
		 00 00 00 00 
		 00 00 00 00 
		 EF 68 38 68 
		 36 72 6B 89 
		 45 75 62 68 
		 43 69 1C 82 
		 A7 74 84 63 
		 23 84 9F 80 
		 1A F4 5A CA 
		 5C A0 71 0C 
		 28 00 FF 36 
		 F0 11 30 03 
		 00 00 00 0C 
	];
};
