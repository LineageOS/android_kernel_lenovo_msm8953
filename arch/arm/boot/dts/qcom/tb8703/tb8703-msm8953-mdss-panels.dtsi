/* Copyright (c) 2015-2016, The Linux Foundation. All rights reserved.
 *
 * This program is free software; you can redistribute it and/or modify
 * it under the terms of the GNU General Public License version 2 and
 * only version 2 as published by the Free Software Foundation.
 *
 * This program is distributed in the hope that it will be useful,
 * but WITHOUT ANY WARRANTY; without even the implied warranty of
 * MERCHANTABILITY or FITNESS FOR A PARTICULAR PURPOSE.  See the
 * GNU General Public License for more details.
 */

#include "dsi-panel-auont51021_1200p_video.dtsi"
#include "dsi-panel-innont51021b_1200p_video.dtsi"

&dsi_auont51021_1200p_vid {	
	qcom,mdss-dsi-panel-timings-phy-v2 = [24 1b 08 09 05 03 04 a0
		24 1b 08 09 05 03 04 a0
		24 1b 08 09 05 03 04 a0
		24 1b 08 09 05 03 04 a0
		24 1f 08 09 05 03 04 a0];
};

&dsi_innont51021b_1200p_vid {	
	qcom,mdss-dsi-panel-timings-phy-v2 = [25 1d 08 0a 06 03 04 a0
		25 1d 08 0a 06 03 04 a0
		25 1d 08 0a 06 03 04 a0
		25 1d 08 0a 06 03 04 a0
		25 20 08 0a 06 03 04 a0];
};



