
qcom,SCUD-4250mah {
	/* #2462823_Longcheer_L15D1P32_4250mAh_averaged_MasterSlave_Jun13th2016*/
	qcom,max-voltage-uv = <4350000>;
	qcom,nom-batt-capacity-mah = <4250>;
	qcom,batt-id-kohm = <100>;
	qcom,battery-beta = <3435>;
	qcom,battery-type = "SCUD-4250mah";
	qcom,chg-rslow-comp-c1 = <3355071>;
	qcom,chg-rslow-comp-c2 = <4173729>;
	qcom,chg-rs-to-rslow = <679636>;
	qcom,chg-rslow-comp-thr = <0x99>;
	qcom,checksum = <0x8EF1>;
	qcom,gui-version = "PMI8950GUI - 2.0.0.16";
	qcom,fg-profile-data = [
		 E3 83 A7 7C
		 99 80 1E 76
		 59 83 AE 5C
		 C3 81 0C 8D
		 38 82 00 9A
		 51 BD 68 CA
		 5A 0E 00 88
		 3F 7D EF 80
		 9D 76 56 83
		 D3 68 77 7A
		 AC 87 5B 82
		 4C 99 82 BC
		 2A C9 5A 0E
		 56 11 28 5A
		 CE 6E B9 FC
		 67 44 26 45
		 6E 43 00 00
		 D4 47 0D 39
		 36 3B 00 00
		 00 00 00 00
		 00 00 00 00
		 A5 69 CB 63
		 7B 6A 4F 89
		 61 77 11 70
		 A5 62 05 82
		 97 75 87 69
		 BB 6D 34 A8
		 1D 00 60 D2
		 57 A0 71 0C
		 28 00 FF 36
		 F0 11 30 03
		 00 00 00 0C
	];
};
