#include "tb8703-msm8953-pinctrl.dtsi"
#include "tb8703-msm8953.dtsi"
#include "tb8703-msm8953-regulator.dtsi"
#include "tb8703-msm8953-audio.dtsi"
#include "tb8703-msm8953-qrd.dtsi"
#include "tb8703-msm8953-camera-sensor-mtp.dtsi"
#include "tb8703-msm8953-audio-mtp.dtsi"
#include "tb8703-msm-pmi8950.dtsi"
#include "tb8703-msm-pm8953.dtsi"
#include "tb8703-msm8953-mtp-2.dtsi"
#include "tb8703-msm8953-mtp.dtsi"
#include "tb8703-msm8953-mdss-panels.dtsi"
