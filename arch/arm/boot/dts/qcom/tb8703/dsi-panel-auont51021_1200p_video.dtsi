/* Copyright (c) 2014, The Linux Foundation. All rights reserved.
 *
 * This program is free software; you can redistribute it and/or modify
 * it under the terms of the GNU General Public License version 2 and
 * only version 2 as published by the Free Software Foundation.
 *
 * This program is distributed in the hope that it will be useful,
 * but WITHOUT ANY WARRANTY; without even the implied warranty of
 * MERCHANTABILITY or FITNESS FOR A PARTICULAR PURPOSE.  See the
 * GNU General Public License for more details.
 */

/*---------------------------------------------------------------------------
 * This file is autogenerated file using gcdb parser. Please do not edit it.
 * Update input XML file to add a new entry or update variable in this file
 * VERSION = "1.0"
 *---------------------------------------------------------------------------*/
&mdss_mdp {
	dsi_auont51021_1200p_vid: qcom,mdss_dsi_auont51021_1200p_video {
		qcom,mdss-dsi-panel-name = "auont51021 1200p video mode dsi panel";
		qcom,mdss-dsi-panel-type = "dsi_video_mode";
		qcom,mdss-dsi-panel-framerate = <60>;
		qcom,mdss-dsi-virtual-channel-id = <0>;
		qcom,mdss-dsi-stream = <0>;
		qcom,mdss-dsi-panel-width = <1200>;
		qcom,mdss-dsi-panel-height = <1920>;
		qcom,mdss-dsi-h-front-porch = <60>;
		qcom,mdss-dsi-h-back-porch = <32>;
		qcom,mdss-dsi-h-pulse-width = <1>;
		qcom,mdss-dsi-h-sync-skew = <0>;
		qcom,mdss-dsi-v-back-porch = <15>;
		qcom,mdss-dsi-v-front-porch = <15>;
		qcom,mdss-dsi-v-pulse-width = <1>;
		qcom,mdss-dsi-h-left-border = <0>;
		qcom,mdss-dsi-h-right-border = <0>;
		qcom,mdss-dsi-v-top-border = <0>;
		qcom,mdss-dsi-v-bottom-border = <0>;
		qcom,mdss-dsi-bpp = <24>;
		qcom,mdss-dsi-underflow-color = <0xff>;
		qcom,mdss-dsi-border-color = <0>;
		qcom,mdss-dsi-on-command = [
			23 01 00 00 05 00 02 8f a5
			23 01 00 00 14 00 02 01 00
			23 01 00 00 00 00 02 8f a5
			23 01 00 00 00 00 02 83 aa
			23 01 00 00 00 00 02 84 11
			23 01 00 00 00 00 02 a9 4b
			23 01 00 00 00 00 02 83 bb
			23 01 00 00 00 00 02 84 22
			23 01 00 00 00 00 02 96 02
			23 01 00 00 00 00 02 90 00
			23 01 00 00 00 00 02 91 80
			23 01 00 00 00 00 02 94 68
			23 01 00 00 00 00 02 95 10
			23 01 00 00 00 00 02 a1 ff
			23 01 00 00 00 00 02 a2 fa
			23 01 00 00 00 00 02 a3 f5
			23 01 00 00 00 00 02 a4 f0
			23 01 00 00 00 00 02 a5 eb
			23 01 00 00 00 00 02 a6 e6
			23 01 00 00 00 00 02 a7 e1
			23 01 00 00 00 00 02 a8 dc
			23 01 00 00 00 00 02 a9 d7
			23 01 00 00 00 00 02 aa d2
			23 01 00 00 00 00 02 ab d2
			23 01 00 00 00 00 02 ac d2
			23 01 00 00 00 00 02 83 00
			23 01 00 00 00 00 02 84 00
			23 01 00 00 00 00 02 9f 00
		];
		qcom,mdss-dsi-off-command = [
			23 01 00 00 00 00 02 83 bb
			23 01 00 00 00 00 02 84 22
			23 01 00 00 00 00 02 96 00
			23 01 00 00 00 00 02 83 00
			23 01 00 00 00 00 02 84 00
			05 01 00 00 78 00 02 10 00
		];

		qcom,mdss-dsi-on-command-state = "dsi_lp_mode";
		qcom,mdss-dsi-off-command-state = "dsi_lp_mode";
		//qcom,cont-splash-enabled;
		qcom,mdss-dsi-h-sync-pulse = <1>;
		qcom,mdss-dsi-traffic-mode = "burst_mode";
		qcom,mdss-dsi-bllp-eof-power-mode;
		qcom,mdss-dsi-bllp-power-mode;
		qcom,mdss-dsi-lane-0-state;
		qcom,mdss-dsi-lane-1-state;
		qcom,mdss-dsi-lane-2-state;
		qcom,mdss-dsi-lane-3-state;
		qcom,mdss-dsi-panel-timings = [f2 3a 28 00 6c 70 2c 3e 2e 03 04 00];
		qcom,mdss-dsi-t-clk-post = <0xe>;
		qcom,mdss-dsi-t-clk-pre = <0x32>;
		qcom,mdss-dsi-bl-min-level = <1>;
		qcom,mdss-dsi-bl-max-level = <255>;
		qcom,mdss-dsi-dma-trigger = "trigger_sw";
		qcom,mdss-dsi-mdp-trigger = "none";
		qcom,mdss-dsi-force-clock-lane-hs;
		qcom,platform-bklight-en-gpio = <&tlmm 46 0>;
		qcom,mdss-dsi-lcden-ctrl = <&tlmm 61 0>;
		qcom,mdss-dsi-bl-pmic-control-type = "bl_ctrl_dcs";
		//qcom,mdss-dsi-bl-pmic-pwm-frequency = <100>;
		//qcom,mdss-dsi-bl-pmic-bank-select = <0>;
		//qcom,mdss-dsi-pwm-gpio = <&pm8953_mpps 4 0>;
		//qcom,panel-supply-entries = <&dsi_panel_pwr_supply>;
		qcom,mdss-pan-physical-width-dimension = <108>;
		qcom,mdss-pan-physical-height-dimension = <172>;
	};
};
