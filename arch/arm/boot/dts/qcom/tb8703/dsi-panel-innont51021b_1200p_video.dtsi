/* Copyright (c) 2014, The Linux Foundation. All rights reserved.
 *
 * This program is free software; you can redistribute it and/or modify
 * it under the terms of the GNU General Public License version 2 and
 * only version 2 as published by the Free Software Foundation.
 *
 * This program is distributed in the hope that it will be useful,
 * but WITHOUT ANY WARRANTY; without even the implied warranty of
 * MERCHANTABILITY or FITNESS FOR A PARTICULAR PURPOSE.  See the
 * GNU General Public License for more details.
 */

/*---------------------------------------------------------------------------
 * This file is autogenerated file using gcdb parser. Please do not edit it.
 * Update input XML file to add a new entry or update variable in this file
 * VERSION = "1.0"
 *---------------------------------------------------------------------------*/
&mdss_mdp {
	dsi_innont51021b_1200p_vid: qcom,mdss_dsi_innont51021b_1200p_video {
		qcom,mdss-dsi-panel-name = "innont51021b 1200p video mode dsi panel";
		qcom,mdss-dsi-panel-type = "dsi_video_mode";
		qcom,mdss-dsi-panel-framerate = <60>;
		qcom,mdss-dsi-virtual-channel-id = <0>;
		qcom,mdss-dsi-stream = <0>;
		qcom,mdss-dsi-panel-width = <1200>;
		qcom,mdss-dsi-panel-height = <1920>;
		qcom,mdss-dsi-h-front-porch = <90>;
		qcom,mdss-dsi-h-back-porch = <60>;
		qcom,mdss-dsi-h-pulse-width = <1>;
		qcom,mdss-dsi-h-sync-skew = <0>;
		qcom,mdss-dsi-v-back-porch = <25>;
		qcom,mdss-dsi-v-front-porch = <35>;
		qcom,mdss-dsi-v-pulse-width = <1>;
		qcom,mdss-dsi-h-left-border = <0>;
		qcom,mdss-dsi-h-right-border = <0>;
		qcom,mdss-dsi-v-top-border = <0>;
		qcom,mdss-dsi-v-bottom-border = <0>;
		qcom,mdss-dsi-bpp = <24>;
		qcom,mdss-dsi-underflow-color = <0xff>;
		qcom,mdss-dsi-border-color = <0>;
		qcom,mdss-dsi-on-command = [
			23 01 00 00 05 00 02 8f a5
			23 01 00 00 14 00 02 01 00
			23 01 00 00 00 00 02 8f a5
			23 01 00 00 00 00 02 83 aa
			23 01 00 00 00 00 02 84 11
			23 01 00 00 00 00 02 a9 4b
			23 01 00 00 00 00 02 83 bb
			23 01 00 00 00 00 02 84 22
			23 01 00 00 00 00 02 96 02
			23 01 00 00 00 00 02 90 00
			23 01 00 00 00 00 02 91 80
			23 01 00 00 00 00 02 94 68
			23 01 00 00 00 00 02 95 10
			23 01 00 00 00 00 02 a1 ff
			23 01 00 00 00 00 02 a2 fa
			23 01 00 00 00 00 02 a3 f5
			23 01 00 00 00 00 02 a4 f0
			23 01 00 00 00 00 02 a5 eb
			23 01 00 00 00 00 02 a6 e6
			23 01 00 00 00 00 02 a7 e1
			23 01 00 00 00 00 02 a8 dc
			23 01 00 00 00 00 02 a9 d7
			23 01 00 00 00 00 02 aa d2
			23 01 00 00 00 00 02 ab d2
			23 01 00 00 00 00 02 ac d2
			23 01 00 00 00 00 02 83 00
			23 01 00 00 00 00 02 84 00
			23 01 00 00 00 00 02 9f 00
			23 01 00 00 00 00 02 8c 04
			23 01 00 00 00 00 02 fd 53
			23 01 00 00 00 00 02 fa 0e
			23 01 00 00 00 00 02 83 aa
			23 01 00 00 00 00 02 84 11
			23 01 00 00 00 00 02 c0 00
			23 01 00 00 00 00 02 c1 02
			23 01 00 00 00 00 02 c2 04
			23 01 00 00 00 00 02 c3 0c
			23 01 00 00 00 00 02 c4 17
			23 01 00 00 00 00 02 c5 1e
			23 01 00 00 00 00 02 c6 25
			23 01 00 00 00 00 02 c7 2b
			23 01 00 00 00 00 02 c8 30
			23 01 00 00 00 00 02 c9 6e
			23 01 00 00 00 00 02 ca 71
			23 01 00 00 00 00 02 cb 83
			23 01 00 00 00 00 02 cc 8b
			23 01 00 00 00 00 02 cd 94
			23 01 00 00 00 00 02 ce 91
			23 01 00 00 00 00 02 cf 94
			23 01 00 00 00 00 02 d0 82
			23 01 00 00 00 00 02 d1 77
			23 01 00 00 00 00 02 d2 75
			23 01 00 00 00 00 02 d3 74
			23 01 00 00 00 00 02 d4 66
			23 01 00 00 00 00 02 d5 32
			23 01 00 00 00 00 02 d6 37
			23 01 00 00 00 00 02 d7 3b
			23 01 00 00 00 00 02 d8 40
			23 01 00 00 00 00 02 d9 44
			23 01 00 00 00 00 02 da 4a
			23 01 00 00 00 00 02 db 4c
			23 01 00 00 00 00 02 dc 50
			23 01 00 00 00 00 02 dd 54
			23 01 00 00 00 00 02 de 00
			23 01 00 00 00 00 02 df 20
			23 01 00 00 00 00 02 e0 26
			23 01 00 00 00 00 02 e1 28
			23 01 00 00 00 00 02 e2 2a
			23 01 00 00 00 00 02 e3 32
			23 01 00 00 00 00 02 e4 3d
			23 01 00 00 00 00 02 e5 46
			23 01 00 00 00 00 02 e6 4b
			23 01 00 00 00 00 02 e7 51
			23 01 00 00 00 00 02 e8 56
			23 01 00 00 00 00 02 e9 b8
			23 01 00 00 00 00 02 ea b9
			23 01 00 00 00 00 02 eb ce
			23 01 00 00 00 00 02 ec d9
			23 01 00 00 00 00 02 ed e0
			23 01 00 00 00 00 02 ee de
			23 01 00 00 00 00 02 ef e0
			23 01 00 00 00 00 02 f0 ce
			23 01 00 00 00 00 02 f1 c3
			23 01 00 00 00 00 02 f2 c0
			23 01 00 00 00 00 02 f3 c1
			23 01 00 00 00 00 02 f4 b2
			23 01 00 00 00 00 02 f5 4c
			23 01 00 00 00 00 02 f6 4f
			23 01 00 00 00 00 02 f7 4f
			23 01 00 00 00 00 02 f8 50
			23 01 00 00 00 00 02 f9 51
			23 01 00 00 00 00 02 fa 51
			23 01 00 00 00 00 02 fb 52
			23 01 00 00 00 00 02 fc 54
			23 01 00 00 00 00 02 fd 54
			23 01 00 00 00 00 02 fe 00
			23 01 00 00 00 00 02 ff 20
			23 01 00 00 00 00 02 83 bb
			23 01 00 00 00 00 02 84 22
			23 01 00 00 00 00 02 c0 00
			23 01 00 00 00 00 02 c1 0b
			23 01 00 00 00 00 02 c2 14
			23 01 00 00 00 00 02 c3 1c
			23 01 00 00 00 00 02 c4 24
			23 01 00 00 00 00 02 c5 2a
			23 01 00 00 00 00 02 c6 30
			23 01 00 00 00 00 02 c7 35
			23 01 00 00 00 00 02 c8 3a
			23 01 00 00 00 00 02 c9 81
			23 01 00 00 00 00 02 ca 84
			23 01 00 00 00 00 02 cb 95
			23 01 00 00 00 00 02 cc a0
			23 01 00 00 00 00 02 cd ad
			23 01 00 00 00 00 02 ce b0
			23 01 00 00 00 00 02 cf b2
			23 01 00 00 00 00 02 d0 ad
			23 01 00 00 00 00 02 d1 b3
			23 01 00 00 00 00 02 d2 be
			23 01 00 00 00 00 02 d3 d0
			23 01 00 00 00 00 02 d4 d0
			23 01 00 00 00 00 02 d5 6f
			23 01 00 00 00 00 02 d6 75
			23 01 00 00 00 00 02 d7 7d
			23 01 00 00 00 00 02 d8 84
			23 01 00 00 00 00 02 d9 8a
			23 01 00 00 00 00 02 da 93
			23 01 00 00 00 00 02 db 9b
			23 01 00 00 00 00 02 dc a2
			23 01 00 00 00 00 02 dd a9
			23 01 00 00 00 00 02 de 00
			23 01 00 00 00 00 02 df 20
			23 01 00 00 00 00 02 e0 26
			23 01 00 00 00 00 02 e1 31
			23 01 00 00 00 00 02 e2 3a
			23 01 00 00 00 00 02 e3 42
			23 01 00 00 00 00 02 e4 4a
			23 01 00 00 00 00 02 e5 52
			23 01 00 00 00 00 02 e6 56
			23 01 00 00 00 00 02 e7 5b
			23 01 00 00 00 00 02 e8 60
			23 01 00 00 00 00 02 e9 cb
			23 01 00 00 00 00 02 ea cc
			23 01 00 00 00 00 02 eb e0
			23 01 00 00 00 00 02 ec ee
			23 01 00 00 00 00 02 ed f9
			23 01 00 00 00 00 02 ee fd
			23 01 00 00 00 00 02 ef fe
			23 01 00 00 00 00 02 f0 f9
			23 01 00 00 00 00 02 f1 ff
			23 01 00 00 00 00 02 f2 09
			23 01 00 00 00 00 02 f3 1d
			23 01 00 00 00 00 02 f4 1c
			23 01 00 00 00 00 02 f5 89
			23 01 00 00 00 00 02 f6 8d
			23 01 00 00 00 00 02 f7 91
			23 01 00 00 00 00 02 f8 94
			23 01 00 00 00 00 02 f9 97
			23 01 00 00 00 00 02 fa 9a
			23 01 00 00 00 00 02 fb a1
			23 01 00 00 00 00 02 fc a6
			23 01 00 00 00 00 02 fd a9
			23 01 00 00 00 00 02 fe 00
			23 01 00 00 00 00 02 ff 2e
			23 01 00 00 00 00 02 83 cc
			23 01 00 00 00 00 02 84 33
			23 01 00 00 00 00 02 c0 00
			23 01 00 00 00 00 02 c1 05
			23 01 00 00 00 00 02 c2 0b
			23 01 00 00 00 00 02 c3 16
			23 01 00 00 00 00 02 c4 22
			23 01 00 00 00 00 02 c5 2b
			23 01 00 00 00 00 02 c6 33
			23 01 00 00 00 00 02 c7 39
			23 01 00 00 00 00 02 c8 3e
			23 01 00 00 00 00 02 c9 89
			23 01 00 00 00 00 02 ca 8e
			23 01 00 00 00 00 02 cb a2
			23 01 00 00 00 00 02 cc ad
			23 01 00 00 00 00 02 cd b8
			23 01 00 00 00 00 02 ce bf
			23 01 00 00 00 00 02 cf c2
			23 01 00 00 00 00 02 d0 c3
			23 01 00 00 00 00 02 d1 d5
			23 01 00 00 00 00 02 d2 e9
			23 01 00 00 00 00 02 d3 08
			23 01 00 00 00 00 02 d4 12
			23 01 00 00 00 00 02 d5 98
			23 01 00 00 00 00 02 d6 a1
			23 01 00 00 00 00 02 d7 ac
			23 01 00 00 00 00 02 d8 b7
			23 01 00 00 00 00 02 d9 c1
			23 01 00 00 00 00 02 da cf
			23 01 00 00 00 00 02 db dc
			23 01 00 00 00 00 02 dc ea
			23 01 00 00 00 00 02 dd f8
			23 01 00 00 00 00 02 de 00
			23 01 00 00 00 00 02 df 2c
			23 01 00 00 00 00 02 e0 26
			23 01 00 00 00 00 02 e1 2b
			23 01 00 00 00 00 02 e2 31
			23 01 00 00 00 00 02 e3 3c
			23 01 00 00 00 00 02 e4 48
			23 01 00 00 00 00 02 e5 53
			23 01 00 00 00 00 02 e6 59
			23 01 00 00 00 00 02 e7 5f
			23 01 00 00 00 00 02 e8 64
			23 01 00 00 00 00 02 e9 d3
			23 01 00 00 00 00 02 ea d6
			23 01 00 00 00 00 02 eb ed
			23 01 00 00 00 00 02 ec fb
			23 01 00 00 00 00 02 ed 04
			23 01 00 00 00 00 02 ee 0c
			23 01 00 00 00 00 02 ef 0e
			23 01 00 00 00 00 02 f0 0f
			23 01 00 00 00 00 02 f1 21
			23 01 00 00 00 00 02 f2 34
			23 01 00 00 00 00 02 f3 55
			23 01 00 00 00 00 02 f4 5e
			23 01 00 00 00 00 02 f5 b2
			23 01 00 00 00 00 02 f6 b9
			23 01 00 00 00 00 02 f7 c0
			23 01 00 00 00 00 02 f8 c7
			23 01 00 00 00 00 02 f9 ce
			23 01 00 00 00 00 02 fa d6
			23 01 00 00 00 00 02 fb e2
			23 01 00 00 00 00 02 fc ee
			23 01 00 00 00 00 02 fd f8
			23 01 00 00 00 00 02 fe f0
			23 01 00 00 00 00 02 ff 2f
		];
		qcom,mdss-dsi-off-command = [
			23 01 00 00 00 00 02 83 bb
			23 01 00 00 00 00 02 84 22
			23 01 00 00 00 00 02 96 00
			23 01 00 00 00 00 02 83 00
			23 01 00 00 00 00 02 84 00
			05 01 00 00 78 00 02 10 00
		];

		qcom,mdss-dsi-on-command-state = "dsi_lp_mode";
		qcom,mdss-dsi-off-command-state = "dsi_lp_mode";
		//qcom,cont-splash-enabled;
		qcom,mdss-dsi-h-sync-pulse = <1>;
		qcom,mdss-dsi-traffic-mode = "burst_mode";
		qcom,mdss-dsi-bllp-eof-power-mode;
		qcom,mdss-dsi-bllp-power-mode;
		qcom,mdss-dsi-lane-0-state;
		qcom,mdss-dsi-lane-1-state;
		qcom,mdss-dsi-lane-2-state;
		qcom,mdss-dsi-lane-3-state;
		qcom,mdss-dsi-panel-timings = [f2 3a 28 00 6c 70 2c 3e 2e 03 04 00];
		qcom,mdss-dsi-t-clk-post = <0xd>;
		qcom,mdss-dsi-t-clk-pre = <0x30>;
		qcom,mdss-dsi-bl-min-level = <1>;
		qcom,mdss-dsi-bl-max-level = <255>;
		qcom,mdss-dsi-dma-trigger = "trigger_sw";
		qcom,mdss-dsi-mdp-trigger = "none";
		qcom,mdss-dsi-force-clock-lane-hs;
		qcom,platform-bklight-en-gpio = <&tlmm 46 0>;
		qcom,mdss-dsi-lcden-ctrl = <&tlmm 61 0>;
		qcom,mdss-dsi-bl-pmic-control-type = "bl_ctrl_dcs";
		//qcom,mdss-dsi-bl-pmic-pwm-frequency = <100>;
		//qcom,mdss-dsi-bl-pmic-bank-select = <0>;
		//qcom,mdss-dsi-pwm-gpio = <&pm8953_mpps 4 0>;
		//qcom,panel-supply-entries = <&dsi_panel_pwr_supply>;
		qcom,mdss-pan-physical-width-dimension = <108>;
		qcom,mdss-pan-physical-height-dimension = <172>;
	};
};
