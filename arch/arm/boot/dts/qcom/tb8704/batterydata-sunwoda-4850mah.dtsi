
qcom,batterydata-sunwoda-4850mah.dtsi {
	/* #2714648_Longcheer_P3590_4850mAh_averaged_MasterSlave_Dec12th2016*/
	qcom,max-voltage-uv = <4400000>;
	qcom,nom-batt-capacity-mah = <4850>;
	qcom,batt-id-kohm = <21>;
	qcom,battery-beta = <3435>;
	qcom,battery-type = "batterydata-sunwoda-4850mah.dtsi";
	qcom,chg-rslow-comp-c1 = <3458575>;
	qcom,chg-rslow-comp-c2 = <5309284>;
	qcom,chg-rs-to-rslow = <613894>;
	qcom,chg-rslow-comp-thr = <0xAC>;
	qcom,checksum = <0x9D5B>;
	qcom,thermal-coefficients = [C5 86 BE 50 D1 37];
	qcom,gui-version = "PMI8950GUI - 2.0.0.16";
	qcom,fg-profile-data = [
		 F2 83 7C 7D 
		 88 81 F9 77 
		 5B 83 46 65 
		 84 82 60 8D 
		 5C 82 72 98 
		 92 B6 88 C2 
		 58 12 F4 83 
		 18 7D 20 81 
		 09 77 63 83 
		 CB 67 9B 88 
		 55 94 56 82 
		 A8 99 FE BC 
		 F3 C9 52 0D 
		 B6 13 3F 59 
		 14 70 4A FC 
		 FB 3F 88 3E 
		 36 3B 00 00 
		 C2 45 0F 2B 
		 00 00 00 00 
		 00 00 00 00 
		 00 00 00 00 
		 16 69 31 68 
		 96 68 92 83 
		 11 75 43 69 
		 75 61 12 81 
		 38 74 7E 68 
		 CA 6E 38 A1 
		 1A 1C 60 DE 
		 5C A0 71 0C 
		 28 00 FF 36 
		 F0 11 30 03 
		 00 00 00 0C 
	];
};
