/* Copyright (c) 2014, The Linux Foundation. All rights reserved.
 *
 * This program is free software; you can redistribute it and/or modify
 * it under the terms of the GNU General Public License version 2 and
 * only version 2 as published by the Free Software Foundation.
 *
 * This program is distributed in the hope that it will be useful,
 * but WITHOUT ANY WARRANTY; without even the implied warranty of
 * MERCHANTABILITY or FITNESS FOR A PARTICULAR PURPOSE.  See the
 * GNU General Public License for more details.
 */

/*---------------------------------------------------------------------------
 * This file is autogenerated file using gcdb parser. Please do not edit it.
 * Update input XML file to add a new entry or update variable in this file
 * VERSION = "1.0"
 *---------------------------------------------------------------------------*/
&mdss_mdp {
	dsi_boent51021_1200p_vid: qcom,mdss_dsi_boent51021_1200p_video {
		qcom,mdss-dsi-panel-name = "boent51021 1200p video mode dsi panel";
		qcom,mdss-dsi-panel-type = "dsi_video_mode";
		qcom,mdss-dsi-panel-framerate = <60>;
		qcom,mdss-dsi-virtual-channel-id = <0>;
		qcom,mdss-dsi-stream = <0>;
		qcom,mdss-dsi-panel-width = <1200>;
		qcom,mdss-dsi-panel-height = <1920>;
		qcom,mdss-dsi-h-front-porch = <88>;
		qcom,mdss-dsi-h-back-porch = <60>;
		qcom,mdss-dsi-h-pulse-width = <1>;
		qcom,mdss-dsi-h-sync-skew = <0>;
		qcom,mdss-dsi-v-back-porch = <25>;
		qcom,mdss-dsi-v-front-porch = <35>;
		qcom,mdss-dsi-v-pulse-width = <1>;
		qcom,mdss-dsi-h-left-border = <0>;
		qcom,mdss-dsi-h-right-border = <0>;
		qcom,mdss-dsi-v-top-border = <0>;
		qcom,mdss-dsi-v-bottom-border = <0>;
		qcom,mdss-dsi-bpp = <24>;
		qcom,mdss-dsi-underflow-color = <0xff>;
		qcom,mdss-dsi-border-color = <0>;
		qcom,mdss-dsi-on-command = [
			23 01 00 00 05 00 02 8f a5
			23 01 00 00 1e 00 02 01 00
			23 01 00 00 01 00 02 8f a5
			23 01 00 00 00 00 02 83 bb
			23 01 00 00 00 00 02 84 22
			23 01 00 00 00 00 02 91 80
			23 01 00 00 00 00 02 94 68
			23 01 00 00 00 00 02 95 11
			23 01 00 00 00 00 02 96 00
			23 01 00 00 00 00 02 83 00
			23 01 00 00 00 00 02 84 00
			23 01 00 00 00 00 02 8c 0e
			23 01 00 00 00 00 02 97 00
			23 01 00 00 00 00 02 fa 0d
			23 01 00 00 00 00 02 fd 13
			23 01 00 00 00 00 02 9f 00
			23 01 00 00 00 00 02 83 aa
			23 01 00 00 00 00 02 84 11
			23 01 00 00 00 00 02 a9 4b
			23 01 00 00 00 00 02 83 aa
			23 01 00 00 00 00 02 84 11
			23 01 00 00 00 00 02 c0 0b
			23 01 00 00 00 00 02 c1 0c
			23 01 00 00 00 00 02 c2 1a
			23 01 00 00 00 00 02 c3 27
			23 01 00 00 00 00 02 c4 34
			23 01 00 00 00 00 02 c5 3f
			23 01 00 00 00 00 02 c6 4a
			23 01 00 00 00 00 02 c7 53
			23 01 00 00 00 00 02 c8 5c
			23 01 00 00 00 00 02 c9 d6
			23 01 00 00 00 00 02 ca de
			23 01 00 00 00 00 02 cb fd
			23 01 00 00 00 00 02 cc 0d
			23 01 00 00 00 00 02 cd 15
			23 01 00 00 00 00 02 ce 19
			23 01 00 00 00 00 02 cf 17
			23 01 00 00 00 00 02 d0 1b
			23 01 00 00 00 00 02 d1 2c
			23 01 00 00 00 00 02 d2 42
			23 01 00 00 00 00 02 d3 61
			23 01 00 00 00 00 02 d4 64
			23 01 00 00 00 00 02 d5 b4
			23 01 00 00 00 00 02 d6 ba
			23 01 00 00 00 00 02 d7 c0
			23 01 00 00 00 00 02 d8 c7
			23 01 00 00 00 00 02 d9 cf
			23 01 00 00 00 00 02 da d9
			23 01 00 00 00 00 02 db e2
			23 01 00 00 00 00 02 dc f3
			23 01 00 00 00 00 02 dd ff
			23 01 00 00 00 00 02 de f8
			23 01 00 00 00 00 02 df 2f
			23 01 00 00 00 00 02 e0 19
			23 01 00 00 00 00 02 e1 1a
			23 01 00 00 00 00 02 e2 24
			23 01 00 00 00 00 02 e3 33
			23 01 00 00 00 00 02 e4 40
			23 01 00 00 00 00 02 e5 4b
			23 01 00 00 00 00 02 e6 56
			23 01 00 00 00 00 02 e7 5f
			23 01 00 00 00 00 02 e8 68
			23 01 00 00 00 00 02 e9 e2
			23 01 00 00 00 00 02 ea ea
			23 01 00 00 00 00 02 eb 09
			23 01 00 00 00 00 02 ec 13
			23 01 00 00 00 00 02 ed 1b
			23 01 00 00 00 00 02 ee 19
			23 01 00 00 00 00 02 ef 1f
			23 01 00 00 00 00 02 f0 25
			23 01 00 00 00 00 02 f1 3c
			23 01 00 00 00 00 02 f2 52
			23 01 00 00 00 00 02 f3 71
			23 01 00 00 00 00 02 f4 76
			23 01 00 00 00 00 02 f5 c6
			23 01 00 00 00 00 02 f6 ce
			23 01 00 00 00 00 02 f7 d6
			23 01 00 00 00 00 02 f8 df
			23 01 00 00 00 00 02 f9 e7
			23 01 00 00 00 00 02 fa f1
			23 01 00 00 00 00 02 fb fa
			23 01 00 00 00 00 02 fc ff
			23 01 00 00 00 00 02 fd ff
			23 01 00 00 00 00 02 fe fc
			23 01 00 00 00 00 02 ff 2f
			23 01 00 00 00 00 02 83 bb
			23 01 00 00 00 00 02 84 22
			23 01 00 00 00 00 02 c0 0b
			23 01 00 00 00 00 02 c1 0c
			23 01 00 00 00 00 02 c2 1a
			23 01 00 00 00 00 02 c3 27
			23 01 00 00 00 00 02 c4 34
			23 01 00 00 00 00 02 c5 3f
			23 01 00 00 00 00 02 c6 4a
			23 01 00 00 00 00 02 c7 53
			23 01 00 00 00 00 02 c8 5c
			23 01 00 00 00 00 02 c9 d6
			23 01 00 00 00 00 02 ca de
			23 01 00 00 00 00 02 cb fd
			23 01 00 00 00 00 02 cc 0d
			23 01 00 00 00 00 02 cd 15
			23 01 00 00 00 00 02 ce 19
			23 01 00 00 00 00 02 cf 17
			23 01 00 00 00 00 02 d0 1b
			23 01 00 00 00 00 02 d1 2c
			23 01 00 00 00 00 02 d2 42
			23 01 00 00 00 00 02 d3 61
			23 01 00 00 00 00 02 d4 64
			23 01 00 00 00 00 02 d5 b4
			23 01 00 00 00 00 02 d6 ba
			23 01 00 00 00 00 02 d7 c0
			23 01 00 00 00 00 02 d8 c7
			23 01 00 00 00 00 02 d9 cf
			23 01 00 00 00 00 02 da d9
			23 01 00 00 00 00 02 db e2
			23 01 00 00 00 00 02 dc f3
			23 01 00 00 00 00 02 dd ff
			23 01 00 00 00 00 02 de f8
			23 01 00 00 00 00 02 df 2f
			23 01 00 00 00 00 02 e0 19
			23 01 00 00 00 00 02 e1 1a
			23 01 00 00 00 00 02 e2 24
			23 01 00 00 00 00 02 e3 33
			23 01 00 00 00 00 02 e4 40
			23 01 00 00 00 00 02 e5 4b
			23 01 00 00 00 00 02 e6 56
			23 01 00 00 00 00 02 e7 5f
			23 01 00 00 00 00 02 e8 68
			23 01 00 00 00 00 02 e9 e2
			23 01 00 00 00 00 02 ea ea
			23 01 00 00 00 00 02 eb 09
			23 01 00 00 00 00 02 ec 13
			23 01 00 00 00 00 02 ed 1b
			23 01 00 00 00 00 02 ee 19
			23 01 00 00 00 00 02 ef 1f
			23 01 00 00 00 00 02 f0 25
			23 01 00 00 00 00 02 f1 3c
			23 01 00 00 00 00 02 f2 52
			23 01 00 00 00 00 02 f3 71
			23 01 00 00 00 00 02 f4 76
			23 01 00 00 00 00 02 f5 c6
			23 01 00 00 00 00 02 f6 ce
			23 01 00 00 00 00 02 f7 d6
			23 01 00 00 00 00 02 f8 df
			23 01 00 00 00 00 02 f9 e7
			23 01 00 00 00 00 02 fa f1
			23 01 00 00 00 00 02 fb fa
			23 01 00 00 00 00 02 fc ff
			23 01 00 00 00 00 02 fd ff
			23 01 00 00 00 00 02 fe fc
			23 01 00 00 00 00 02 ff 2f
			23 01 00 00 00 00 02 83 cc
			23 01 00 00 00 00 02 84 33
			23 01 00 00 00 00 02 c0 0b
			23 01 00 00 00 00 02 c1 0c
			23 01 00 00 00 00 02 c2 1a
			23 01 00 00 00 00 02 c3 27
			23 01 00 00 00 00 02 c4 34
			23 01 00 00 00 00 02 c5 3f
			23 01 00 00 00 00 02 c6 4a
			23 01 00 00 00 00 02 c7 53
			23 01 00 00 00 00 02 c8 5c
			23 01 00 00 00 00 02 c9 d6
			23 01 00 00 00 00 02 ca de
			23 01 00 00 00 00 02 cb fd
			23 01 00 00 00 00 02 cc 0d
			23 01 00 00 00 00 02 cd 15
			23 01 00 00 00 00 02 ce 19
			23 01 00 00 00 00 02 cf 17
			23 01 00 00 00 00 02 d0 1b
			23 01 00 00 00 00 02 d1 2c
			23 01 00 00 00 00 02 d2 42
			23 01 00 00 00 00 02 d3 61
			23 01 00 00 00 00 02 d4 64
			23 01 00 00 00 00 02 d5 b4
			23 01 00 00 00 00 02 d6 ba
			23 01 00 00 00 00 02 d7 c0
			23 01 00 00 00 00 02 d8 c7
			23 01 00 00 00 00 02 d9 cf
			23 01 00 00 00 00 02 da d9
			23 01 00 00 00 00 02 db e2
			23 01 00 00 00 00 02 dc f3
			23 01 00 00 00 00 02 dd ff
			23 01 00 00 00 00 02 de f8
			23 01 00 00 00 00 02 df 2f
			23 01 00 00 00 00 02 e0 19
			23 01 00 00 00 00 02 e1 1a
			23 01 00 00 00 00 02 e2 24
			23 01 00 00 00 00 02 e3 33
			23 01 00 00 00 00 02 e4 40
			23 01 00 00 00 00 02 e5 4b
			23 01 00 00 00 00 02 e6 56
			23 01 00 00 00 00 02 e7 5f
			23 01 00 00 00 00 02 e8 68
			23 01 00 00 00 00 02 e9 e2
			23 01 00 00 00 00 02 ea ea
			23 01 00 00 00 00 02 eb 09
			23 01 00 00 00 00 02 ec 13
			23 01 00 00 00 00 02 ed 1b
			23 01 00 00 00 00 02 ee 19
			23 01 00 00 00 00 02 ef 1f
			23 01 00 00 00 00 02 f0 25
			23 01 00 00 00 00 02 f1 3c
			23 01 00 00 00 00 02 f2 52
			23 01 00 00 00 00 02 f3 71
			23 01 00 00 00 00 02 f4 76
			23 01 00 00 00 00 02 f5 c6
			23 01 00 00 00 00 02 f6 ce
			23 01 00 00 00 00 02 f7 d6
			23 01 00 00 00 00 02 f8 df
			23 01 00 00 00 00 02 f9 e7
			23 01 00 00 00 00 02 fa f1
			23 01 00 00 00 00 02 fb fa
			23 01 00 00 00 00 02 fc ff
			23 01 00 00 00 00 02 fd ff
			23 01 00 00 00 00 02 fe fc
			23 01 00 00 00 00 02 ff 2f
		];
		qcom,mdss-dsi-off-command =  [
			23 01 00 00 00 00 02 83 00 
			23 01 00 00 78 00 02 84 00 
			05 01 00 00 78 00 02 10 00
		];

		qcom,mdss-dsi-on-command-state = "dsi_lp_mode";
		qcom,mdss-dsi-off-command-state = "dsi_lp_mode";
		//qcom,cont-splash-enabled;
		qcom,mdss-dsi-h-sync-pulse = <1>;
		qcom,mdss-dsi-traffic-mode = "burst_mode";
		qcom,mdss-dsi-bllp-eof-power-mode;
		qcom,mdss-dsi-bllp-power-mode;
		qcom,mdss-dsi-lane-0-state;
		qcom,mdss-dsi-lane-1-state;
		qcom,mdss-dsi-lane-2-state;
		qcom,mdss-dsi-lane-3-state;
		qcom,mdss-dsi-panel-timings = [f2 3a 28 00 6c 70 2c 3e 2e 03 04 00];
		qcom,mdss-dsi-t-clk-post = <0xe>;
		qcom,mdss-dsi-t-clk-pre = <0x33>;
		qcom,mdss-dsi-bl-min-level = <1>;
		qcom,mdss-dsi-bl-max-level = <255>;
		qcom,mdss-dsi-dma-trigger = "trigger_sw";
		qcom,mdss-dsi-mdp-trigger = "none";
		qcom,mdss-dsi-force-clock-lane-hs;
		qcom,platform-bklight-en-gpio = <&tlmm 46 0>;
		qcom,mdss-dsi-lcden-ctrl = <&tlmm 61 0>;
		qcom,mdss-dsi-bl-pmic-control-type = "bl_ctrl_dcs";
		//qcom,mdss-dsi-bl-pmic-pwm-frequency = <100>;
		//qcom,mdss-dsi-bl-pmic-bank-select = <0>;
		//qcom,mdss-dsi-pwm-gpio = <&pm8953_mpps 4 0>;
		//qcom,panel-supply-entries = <&dsi_panel_pwr_supply>;
		qcom,mdss-pan-physical-width-dimension = <108>;
		qcom,mdss-pan-physical-height-dimension = <172>;
	};
};
