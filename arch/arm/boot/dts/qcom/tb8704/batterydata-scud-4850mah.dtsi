
qcom,scud-4850mah {
	/* #2724181_Longcheer_P3590scud_4850mAh_averaged_MasterSlave_Dec19th2016*/
	qcom,max-voltage-uv = <4400000>;
	qcom,nom-batt-capacity-mah = <4850>;
	qcom,batt-id-kohm = <56>;
	qcom,battery-beta = <3380>;
	qcom,battery-type = "scud_4850mah";
	qcom,chg-rslow-comp-c1 = <1905028>;
	qcom,chg-rslow-comp-c2 = <1301488>;
	qcom,chg-rs-to-rslow = <723814>;
	qcom,chg-rslow-comp-thr = <0x99>;
	qcom,checksum = <0xBD9A>;
	qcom,thermal-coefficients = [DA 86 F0 50 08 3C];
	qcom,gui-version = "PMI8950GUI - 2.0.0.16";
	qcom,fg-profile-data = [
		 E2 83 D4 7C 
		 19 81 40 77 
		 63 83 72 6F 
		 13 89 41 94 
		 52 82 86 99 
		 EE BC F7 C9 
		 55 0E 07 88 
		 15 7E FA 81 
		 6A 7C 50 83 
		 76 70 DD 69 
		 CF 7F 6B 82 
		 03 99 48 BC 
		 EC C8 5A 0C 
		 43 13 B4 59 
		 14 70 71 FD 
		 E0 35 88 3E 
		 FD 16 00 00 
		 F3 44 22 38 
		 FD 36 00 00 
		 00 00 00 00 
		 00 00 00 00 
		 95 6A AF 69 
		 1E 70 25 83 
		 73 74 90 62 
		 E2 60 2D 80 
		 95 6F EA 60 
		 D7 74 86 89 
		 1A EB 5B 0F 
		 5D A0 71 0C 
		 28 00 FF 36 
		 F0 11 30 03 
		 00 00 00 0C 
	];
};
